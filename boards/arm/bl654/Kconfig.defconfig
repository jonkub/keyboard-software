## boards/arm/bl654/Kconfig.defconfig
```kconfig
# Copyright (c) 2022 Nordic Semiconductor ASA
# SPDX-License-Identifier: Apache-2.0

if BOARD_BL654

config BOARD
	default "bl654"

config BT_CTLR
   default BT

endif
```

## boards/arm/bl654/bl654_defconfig
```kconfig
# Copyright (c) 2022 Nordic Semiconductor ASA
# SPDX-License-Identifier: Apache-2.0

CONFIG_SOC_SERIES_NRF52X=y
CONFIG_SOC_NRF52840_QIAA=y
CONFIG_BOARD_BL654=y

# Enable MPU
CONFIG_ARM_MPU=y

# Enable hardware stack protection
CONFIG_HW_STACK_PROTECTION=y
CONFIG_CLOCK_CONTROL_NRF_K32SRC_RC=y
CONFIG_CLOCK_CONTROL_NRF_K32SRC_RC_CALIBRATION=y
```

## drivers/kscan/Kconfig
```kconfig
menuconfig VPK_KSCAN_MATRIX
    bool "KSCAN backend for gpio matrix"
    depends on KSCAN
    help
      Enable GPIO-based keyboard matrix driver

if VPK_KSCAN_MATRIX

config VPK_KSCAN_MATRIX_PERIOD_US
  int "Time between each scan of the gpio matrix in us"
  default 1000
  range 200 1000000
  help
    Time in between each scan of the gpio keyboard matrix.
    Set in us and with a range of 200us to 10s. Lower values
    result in a lower average input latency.

config VPK_KSCAN_MATRIX_DEBOUNCE_US
  int "Debounce time for each key"
  default 5000
  range 200 5000
  help
    Time after a key was pressed or released in which the 
    state can't change again. Set in us with a range of 200us
    to 5ms. Exceedingly low values may result in errors due 
    to switch "bouncing". 

endif #VPK_KSCAN_MATRIX
```

## drivers/zephyr/dts/bindings/kscan/vpk,kscan-matrix.yaml
```yaml
description: Vampunzels Keyboard matrix

compatible: "vpk,kscan-matrix"

include: kscan.yaml

properties:
  row-gpios:
    type: phandle-array
    required: true
  col-gpios:
    type: phandle-array
    required: true
```
